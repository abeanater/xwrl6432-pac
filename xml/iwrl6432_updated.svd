# IWRL6432 register map
File version: 1.0
CPU: CM4 1.0, other endian, MPU, FPU, 3 interrupt priority bits
Registers are 32-bit, read-write, reset 0x0 unless marked. A register's access mark holds for its fields unless they carry their own. Offsets are from the block's base; [hi:lo] are bit positions; {n}, {i} and the like mark numbered series.

## TOP_DEBUGSS
Base 0x5CA00000
0x00 ONEMCU_APB_BASE — Start Address of ROM Table
  [31:0] ONEMCU_APB_BASE — [31:0] OneMCU APB Space : Start Address of ROM Table
0xFFC ONEMCU_APB_BASE_END — End Address of ROM Table
  [31:0] ONEMCU_APB_BASE_END — [31:0] OneMCU APB Space : Endt Address of ROM Table
0x1000 ONEMCU_CTI_CONTROL — http://infocenter.arm.com/help/topic/com.arm.doc.ddi0314h/Chdjefbi.html http://infocenter.arm.com/help/topic/com.arm.doc.ddi0314h/Chdefejc.html
  [31:0] ONEMCU_CTI_CONTROL — [31:0] http://infocenter.arm.com/help/topic/com.arm.doc.ddi0480e/CHDGDIHE.html http://infocenter.arm.com/help/topic/com.arm.doc.ddi0480e/CHDHBDIA.html
0x1010 ONEMCU_CTI_INTACK
0x1014 ONEMCU_CTI_APPSET
0x1018 ONEMCU_CTI_APPCLEAR
0x101C ONEMCU_CTI_APPPULSE
{0x1020+4i} ONEMCU_CTI_INEN{i} (i=0..7)
{0x10A0+4i} ONEMCU_CTI_OUTEN{i} (i=0..7)
0x1130 ONEMCU_CTI_TRIGINSTATUS
0x1134 ONEMCU_CTI_TRIGOUTSTATUS
0x1138 ONEMCU_CTI_CHINSTATUS
0x113C ONEMCU_CTI_CHOUTSTATUS
0x1140 ONEMCU_CTI_GATE
0x1144 ONEMCU_CTI_ASICCTL
0x1EDC ONEMCU_CTI_ITCHINACK
0x1EE0 ONEMCU_CTI_ITTRIGINACK
0x1EE4 ONEMCU_CTI_ITCHOUT
0x1EE8 ONEMCU_CTI_ITTRIGOUT
0x1EEC ONEMCU_CTI_ITCHOUTACK
0x1EF0 ONEMCU_CTI_ITTRIGOUTACK
0x1EF4 ONEMCU_CTI_ITCHIN
0x1EF8 ONEMCU_CTI_ITTRIGIN
0x1F00 ONEMCU_CTI_ITCTRL
0x1FA0 ONEMCU_CTI_Claim_Tag_Set
0x1FA4 ONEMCU_CTI_Claim_Tag_Clear
0x1FB0 ONEMCU_CTI_Lock_Access_Register
0x1FB4 ONEMCU_CTI_Lock_Status_Register
0x1FB8 ONEMCU_CTI_Authentication_Status
0x1FC8 ONEMCU_CTI_Device_ID
0x1FCC ONEMCU_CTI_Device_Type_Identifier
{0x1FC0+4i} ONEMCU_CTI_PeripheralID{i} (i=4..7)
{0x1FE0+4i} ONEMCU_CTI_PeripheralID{i} (i=0..3)
{0x1FF0+4i} ONEMCU_CTI_Component_ID{i} (i=0..3)
0x2000 ONEMCU_TPIU_SPORTSZ — Supported port sizes
  [31:0] ONEMCU_TPIU_SPORTSZ — [31:0] Supported port sizes
0x2004 ONEMCU_TPIU_CPORTSZ — Current port size
  [31:0] ONEMCU_TPIU_CPORTSZ — [31:0] Current port size
0x2100 ONEMCU_TPIU_STRIGM — Supported trigger modes
  [31:0] ONEMCU_TPIU_STRIGM — [31:0] Supported trigger modes
0x2104 ONEMCU_TPIU_TRIGCNT — Trigger counter value
  [31:0] ONEMCU_TPIU_TRIGCNT — [31:0] Trigger counter value
0x2108 ONEMCU_TPIU_TRIGMUL — Trigger multiplier
  [31:0] ONEMCU_TPIU_TRIGMUL — [31:0] Trigger multiplier
0x2200 ONEMCU_TPIU_STSTPTRN — Supported test pattern/modes
  [31:0] ONEMCU_TPIU_STSTPTRN — [31:0] Supported test pattern/modes
0x2204 ONEMCU_TPIU_CTSTPTRN — Current test pattern/mode
  [31:0] ONEMCU_TPIU_CTSTPTRN — [31:0] Current test pattern/mode
0x2208 ONEMCU_TPIU_TPRCNTR — Test pattern repeat counter
  [31:0] ONEMCU_TPIU_TPRCNTR — [31:0] Test pattern repeat counter
0x2300 ONEMCU_TPIU_FFSTS — Formatter and flush status
  [31:0] ONEMCU_TPIU_FFSTS — [31:0] Formatter and flush status
0x2304 ONEMCU_TPIU_FFCTRL — Formatter and flush control
  [31:0] ONEMCU_TPIU_FFCTRL — [31:0] Formatter and flush control
0x2308 ONEMCU_TPIU_FSCNTR — Formatter synchronization counter
  [31:0] ONEMCU_TPIU_FSCNTR — [31:0] Formatter synchronization counter
0x2400 ONEMCU_TPIU_EXCTLIN — EXTCTL In Port
  [31:0] ONEMCU_TPIU_EXCTLIN — [31:0] EXTCTL In Port
0x2404 ONEMCU_TPIU_EXCTLOUT — EXTCTL Out Port
  [31:0] ONEMCU_TPIU_EXCTLOUT — [31:0] EXTCTL Out Port
0x2EE4 ONEMCU_TPIU_ITTRFLINACK — Integration Register, ITTRFLINACK
  [31:0] ONEMCU_TPIU_ITTRFLINACK — [31:0] Integration Register, ITTRFLINACK
0x2EE8 ONEMCU_TPIU_ITTRFLIN — Integration Register, ITTRFLIN
  [31:0] ONEMCU_TPIU_ITTRFLIN — [31:0] Integration Register, ITTRFLIN
0x2EEC ONEMCU_TPIU_ITATBDATA0 — Integration Register, ITATBDATA0
  [31:0] ONEMCU_TPIU_ITATBDATA0 — [31:0] Integration Register, ITATBDATA0
0x2EF0 ONEMCU_TPIU_ITATBCTR2 — Integration Register, ITATBCTR2
  [31:0] ONEMCU_TPIU_ITATBCTR2 — [31:0] Integration Register, ITATBCTR2
0x2EF4 ONEMCU_TPIU_ITATBCTR1 — Integration Register, ITATBCTR1
  [31:0] ONEMCU_TPIU_ITATBCTR1 — [31:0] Integration Register, ITATBCTR1
0x2EF8 ONEMCU_TPIU_ITATBCTR0 — Integration Register, ITATBCTR0
  [31:0] ONEMCU_TPIU_ITATBCTR0 — [31:0] Integration Register, ITATBCTR0
0x2F00 ONEMCU_TPIU_ITCTRL — Integration Mode Control Register
  [31:0] ONEMCU_TPIU_ITCTRL — [31:0] Integration Mode Control Register
0x2FA0 ONEMCU_TPIU_CLAIMSET — Claim Tag Set
  [31:0] ONEMCU_TPIU_CLAIMSET — [31:0] Claim Tag Set
0x2FA4 ONEMCU_TPIU_CLAIMCLR — Claim Tag Clear
  [31:0] ONEMCU_TPIU_CLAIMCLR — [31:0] Claim Tag Clear
0x2FB0 ONEMCU_TPIU_LAR — Lock status
  [31:0] ONEMCU_TPIU_LAR — [31:0] Lock status
0x2FB4 ONEMCU_TPIU_LSR — Lock Access
  [31:0] ONEMCU_TPIU_LSR — [31:0] Lock Access
0x2FB8 ONEMCU_TPIU_AUTHSTATUS — Authentication status
  [31:0] ONEMCU_TPIU_AUTHSTATUS — [31:0] Authentication status
0x2FC8 ONEMCU_TPIU_DEVID — Device ID
  [31:0] ONEMCU_TPIU_DEVID — [31:0] Device ID
0x2FCC ONEMCU_TPIU_DEVTYPE — Device type identifier
  [31:0] ONEMCU_TPIU_DEVTYPE — [31:0] Device type identifier
{0x2FC0+4i} ONEMCU_TPIU_PIDR{i} (i=4..7) — Peripheral ID{i}
  [31:0] ONEMCU_TPIU_PIDR{i} — [31:0] Peripheral ID{i}
{0x2FE0+4i} ONEMCU_TPIU_PIDR{i} (i=0..3) — Peripheral ID{i}
  [31:0] ONEMCU_TPIU_PIDR{i} — [31:0] Peripheral ID{i}
{0x2FF0+4i} ONEMCU_TPIU_CIDR{i} (i=0..3) — Component ID{i}
  [31:0] ONEMCU_TPIU_CIDR{i} — [31:0] Component ID{i}
0x10000 APP_CM4_CTI_CONTROL — http://infocenter.arm.com/help/topic/com.arm.doc.ddi0314h/Chdjefbi.html http://infocenter.arm.com/help/topic/com.arm.doc.ddi0314h/Chdefejc.html
  [31:0] APP_CM4_CTI_CONTROL — [31:0] http://infocenter.arm.com/help/topic/com.arm.doc.ddi0480e/CHDGDIHE.html http://infocenter.arm.com/help/topic/com.arm.doc.ddi0480e/CHDHBDIA.html
0x10010 APP_CM4_CTI_INTACK
0x10014 APP_CM4_CTI_APPSET
0x10018 APP_CM4_CTI_APPCLEAR
0x1001C APP_CM4_CTI_APPPULSE
{0x10020+4i} APP_CM4_CTI_INEN{i} (i=0..7)
{0x100A0+4i} APP_CM4_CTI_OUTEN{i} (i=0..7)
0x10130 APP_CM4_CTI_TRIGINSTATUS
0x10134 APP_CM4_CTI_TRIGOUTSTATUS
0x10138 APP_CM4_CTI_CHINSTATUS
0x1013C APP_CM4_CTI_CHOUTSTATUS
0x10140 APP_CM4_CTI_GATE
0x10144 APP_CM4_CTI_ASICCTL
0x10EDC APP_CM4_CTI_ITCHINACK
0x10EE0 APP_CM4_CTI_ITTRIGINACK
0x10EE4 APP_CM4_CTI_ITCHOUT
0x10EE8 APP_CM4_CTI_ITTRIGOUT
0x10EEC APP_CM4_CTI_ITCHOUTACK
0x10EF0 APP_CM4_CTI_ITTRIGOUTACK
0x10EF4 APP_CM4_CTI_ITCHIN
0x10EF8 APP_CM4_CTI_ITTRIGIN
0x10F00 APP_CM4_CTI_ITCTRL
0x10FA0 APP_CM4_CTI_Claim_Tag_Set
0x10FA4 APP_CM4_CTI_Claim_Tag_Clear
0x10FB0 APP_CM4_CTI_Lock_Access_Register
0x10FB4 APP_CM4_CTI_Lock_Status_Register
0x10FB8 APP_CM4_CTI_Authentication_Status
0x10FC8 APP_CM4_CTI_Device_ID
0x10FCC APP_CM4_CTI_Device_Type_Identifier
{0x10FC0+4i} APP_CM4_CTI_PeripheralID{i} (i=4..7)
{0x10FE0+4i} APP_CM4_CTI_PeripheralID{i} (i=0..3)
{0x10FF0+4i} APP_CM4_CTI_Component_ID{i} (i=0..3)
0x11000 FEC_CM3_CTI_CONTROL — http://infocenter.arm.com/help/topic/com.arm.doc.ddi0314h/Chdjefbi.html http://infocenter.arm.com/help/topic/com.arm.doc.ddi0314h/Chdefejc.html
0x11010 FEC_CM3_CTI_INTACK
0x11014 FEC_CM3_CTI_APPSET
0x11018 FEC_CM3_CTI_APPCLEAR
0x1101C FEC_CM3_CTI_APPPULSE
{0x11020+4i} FEC_CM3_CTI_INEN{i} (i=0..7)
{0x110A0+4i} FEC_CM3_CTI_OUTEN{i} (i=0..7)
0x11130 FEC_CM3_CTI_TRIGINSTATUS
0x11134 FEC_CM3_CTI_TRIGOUTSTATUS
0x11138 FEC_CM3_CTI_CHINSTATUS
0x1113C FEC_CM3_CTI_CHOUTSTATUS
0x11140 FEC_CM3_CTI_GATE
0x11144 FEC_CM3_CTI_ASICCTL
0x11EDC FEC_CM3_CTI_ITCHINACK
0x11EE0 FEC_CM3_CTI_ITTRIGINACK
0x11EE4 FEC_CM3_CTI_ITCHOUT
0x11EE8 FEC_CM3_CTI_ITTRIGOUT
0x11EEC FEC_CM3_CTI_ITCHOUTACK
0x11EF0 FEC_CM3_CTI_ITTRIGOUTACK
0x11EF4 FEC_CM3_CTI_ITCHIN
0x11EF8 FEC_CM3_CTI_ITTRIGIN
0x11F00 FEC_CM3_CTI_ITCTRL
0x11FA0 FEC_CM3_CTI_Claim_Tag_Set
0x11FA4 FEC_CM3_CTI_Claim_Tag_Clear
0x11FB0 FEC_CM3_CTI_Lock_Access_Register
0x11FB4 FEC_CM3_CTI_Lock_Status_Register
0x11FB8 FEC_CM3_CTI_Authentication_Status
0x11FC8 FEC_CM3_CTI_Device_ID
0x11FCC FEC_CM3_CTI_Device_Type_Identifier
{0x11FC0+4i} FEC_CM3_CTI_PeripheralID{i} (i=4..7)
{0x11FE0+4i} FEC_CM3_CTI_PeripheralID{i} (i=0..3)
{0x11FF0+4i} FEC_CM3_CTI_Component_ID{i} (i=0..3)
